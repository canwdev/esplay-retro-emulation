## esplay-sdk/hal-drivers/Kconfig.projbuild
```kconfig
menu "Hardware configuration"

choice EMULATOR_HARDWARE
	prompt "Hardware to run on"
	default ESPLAY_MICRO_HW
	help
		This emulator can run on various types of hardware. Select what you have here.

config ESPLAY20_HW
	bool "ESPlay 2.0 Hardware"

config ESPLAY_MICRO_HW
	bool "ESPlay Micro Hardware"

config HW_CUSTOM
	bool "Custom hardware"

endchoice

choice HW_LCD_TYPE_SEL
	prompt "LCD type"
	default HW_LCD_TYPE_ILI9341
	depends on HW_CUSTOM

config HW_LCD_TYPE_ILI9341
	bool "ILI9341 LCD"

config HW_LCD_TYPE_ILI9342
	bool "ILI9342 LCD"

endchoice

config HW_LCD_TYPE
	int
	default 0 if ESPLAY20_HW
  default 0 if ESPLAY_MICRO_HW
	default 0 if HW_LCD_TYPE_ILI9341
	default 1 if HW_LCD_TYPE_ILI9342

endmenu

menu "Audio I2S speaker"

config AUDIO_I2S_BCLK_GPIO
	int "I2S bit clock (BCLK) GPIO"
	default 26
	range 0 39

config AUDIO_I2S_WS_GPIO
	int "I2S word select (LRCK/WS) GPIO"
	default 25
	range 0 39

config AUDIO_I2S_DOUT_GPIO
	int "I2S data out (DOUT) GPIO"
	default 19
	range 0 39
	help
	  ESPlay Micro (UDA1334): ESP32 IO19 → DAC DIN. Change if your wiring differs.

config AUDIO_AMP_GPIO
	int "Internal speaker amp enable GPIO (-1 = none)"
	default 4
	range -1 39
	help
	  Legacy ESPlay / ESPlay Micro (see esplay-hal pin_definitions): GPIO 4 high enables
	  PAM8403 (external speaker). Headphones work without this. Use -1 if your board has no SHDN line.

endmenu
```

## launcher/nes_app/sdkconfig.defaults
```kconfig
# Fixed 16MB flash
CONFIG_ESPTOOLPY_FLASHSIZE_16MB=y
CONFIG_ESPTOOLPY_HEADER_FLASHSIZE_UPDATE=n

# ESPlay Micro I2S audio GPIO
CONFIG_AUDIO_I2S_BCLK_GPIO=26
CONFIG_AUDIO_I2S_WS_GPIO=25
CONFIG_AUDIO_I2S_DOUT_GPIO=19
CONFIG_AUDIO_AMP_GPIO=4

# No WiFi
CONFIG_ESP_WIFI_ENABLED=n

# UTF-8 SD long filenames
CONFIG_FATFS_API_ENCODING_UTF_8=y
CONFIG_FATFS_LFN_HEAP=y

# Keep FATFS internal buffers in DMA-capable internal RAM
CONFIG_FATFS_ALLOC_PREFER_EXTRAM=n

# PSRAM for framebuffer
CONFIG_SPIRAM=y
CONFIG_PARTITION_TABLE_CUSTOM=y
CONFIG_PARTITION_TABLE_MD5=y

# CPU at 240MHz
CONFIG_ESP_DEFAULT_CPU_FREQ_MHZ_240=y
```
